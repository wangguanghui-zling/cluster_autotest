/*@!Encoding:936*/
includes
{
  
}

variables
{
  message GW_BCS_2_B msg260;
}


on sysvar GW_BCS_2_B_260::BCS_VehSpd{
  msg260.BCS_VehSpd.phys = @this; //phys发送物理值
  output(msg260);
}

on sysvar GW_BCS_2_B_260::BCS_VehSpdVD{
  msg260.BCS_VehSpdVD.phys = @this; //phys发送物理值
  output(msg260);
}